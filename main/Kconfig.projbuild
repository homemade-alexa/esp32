## main/Kconfig.projbuild
```kconfig
menu "Alexa Configuration"

config WIFI_SSID
    string "WiFi SSID"
    default "myssid"
    help
        SSID (network name) to connect to.

config WIFI_PASSWORD
    string "WiFi Password"
    default "mypassword"
    help
        WiFi password (WPA, WPA2, WPA3).

config SERVER_HOST
    string "Server host and port"
    default "YOUR_SERVER_IP:8080"
    help
        Host and port of the backend server (e.g. 192.168.0.144:8080).
        Used to construct the WebSocket URL (ws://<host>/ws/internal)
        and the STT endpoint (http://<host>/api/internal/stt).

    menu "Debugging"

    config WILLOW_DEBUG_LOG
        bool "Debug logging"
        help
            Set all log levels to debug

    config WILLOW_DEBUG_MEM
        bool "Debug memory"
        help
            Periodically print memory debugging information

    config WILLOW_DEBUG_RUNTIME_STATS
        bool "Debug runtime stats"
        select FREERTOS_GENERATE_RUN_TIME_STATS
        help
            Periodically print runtime stats

    config WILLOW_DEBUG_TASKS
        bool "Debug tasks"
        select FREERTOS_USE_STATS_FORMATTING_FUNCTIONS
        select FREERTOS_USE_TRACE_FACILITY
        help
            Periodically print task list

    config WILLOW_DEBUG_TIMERS
        bool "Debug timers"
        help
            Periodically print timer information

    endmenu

endmenu
```

## sdkconfig.defaults
```kconfig
CONFIG_ADC_SUPPRESS_DEPRECATE_WARN=y
# CONFIG_BOOTLOADER_APP_ANTI_ROLLBACK is not set
CONFIG_BOOTLOADER_APP_ROLLBACK_ENABLE=y
CONFIG_BOOTLOADER_COMPILER_OPTIMIZATION_PERF=y
CONFIG_COMPILER_OPTIMIZATION_PERF=y
# CONFIG_ETH_USE_SPI_ETHERNET is not set
CONFIG_ESP32S3_DATA_CACHE_64KB=y
CONFIG_ESP32S3_DATA_CACHE_LINE_64B=y
CONFIG_ESP_DEFAULT_CPU_FREQ_MHZ_240=y
CONFIG_ESP32S3_INSTRUCTION_CACHE_32KB=y
CONFIG_SPIRAM=y
CONFIG_ESP32_S3_BOX_3_BOARD=y
# CONFIG_ESP_WIFI_NVS_ENABLED is not set
CONFIG_ESP_WIFI_STATIC_RX_BUFFER_NUM=10
CONFIG_ESP_WIFI_AMSDU_TX_ENABLED=y
CONFIG_ESP_WIFI_RX_BA_WIN=6
CONFIG_ESPTOOLPY_FLASHSIZE_16MB=y
CONFIG_ESPTOOLPY_MONITOR_BAUD_2MB=y
CONFIG_ESP_HTTP_CLIENT_ENABLE_BASIC_AUTH=y
CONFIG_ESP_MAIN_TASK_STACK_SIZE=16384
# CONFIG_ESP_PHY_CALIBRATION_AND_DATA_STORAGE is not set
CONFIG_ESP_PHY_RF_CAL_FULL=y
CONFIG_ESP_TASK_WDT_PANIC=y
CONFIG_ESP_TASK_WDT_TIMEOUT_S=10
CONFIG_ESP_TLS_CLIENT_SESSION_TICKETS=y
CONFIG_ESP_TLS_INSECURE=y
CONFIG_ESP_TLS_SKIP_SERVER_CERT_VERIFY=y
# CONFIG_ESP_WIFI_SOFTAP_SUPPORT is not set
CONFIG_FREERTOS_ENABLE_BACKWARD_COMPATIBILITY=y
CONFIG_FREERTOS_HZ=1000
CONFIG_GDMA_CTRL_FUNC_IN_IRAM=y
CONFIG_GPTIMER_SUPPRESS_DEPRECATE_WARN=y
CONFIG_I2S_SUPPRESS_DEPRECATE_WARN=y
CONFIG_LCD_RGB_ISR_IRAM_SAFE=y
CONFIG_LOG_TIMESTAMP_SOURCE_SYSTEM=y
CONFIG_LV_ATTRIBUTE_FAST_MEM_USE_IRAM=y
# CONFIG_LV_BUILD_EXAMPLES is not set
CONFIG_LV_COLOR_16_SWAP=y
CONFIG_LV_DISP_DEF_REFR_PERIOD=10
CONFIG_LV_FS_POSIX_LETTER=65
CONFIG_LV_FS_POSIX_PATH=""
CONFIG_LV_FS_POSIX_CACHE_SIZE=0
CONFIG_LV_FONT_DEFAULT_MONTSERRAT_24=y
# CONFIG_LV_FONT_MONTSERRAT_14 is not set
CONFIG_LV_MEMCPY_MEMSET_STD=y
CONFIG_LV_MEM_CUSTOM=y
CONFIG_LV_MEM_CUSTOM_INCLUDE="stdlib.h"
# CONFIG_LV_USE_ARC is not set
# CONFIG_LV_USE_BAR is not set
# CONFIG_LV_USE_BTNMATRIX is not set
# CONFIG_LV_USE_CALENDAR is not set
# CONFIG_LV_USE_CALENDAR_HEADER_ARROW is not set
# CONFIG_LV_USE_CALENDAR_HEADER_DROPDOWN is not set
# CONFIG_LV_USE_CHART is not set
# CONFIG_LV_USE_COLORWHEEL is not set
# CONFIG_LV_USE_IMGBTN is not set
# CONFIG_LV_USE_KEYBOARD is not set
# CONFIG_LV_USE_LED is not set
# CONFIG_LV_USE_LIST is not set
# CONFIG_LV_USE_MENU is not set
# CONFIG_LV_USE_METER is not set
# CONFIG_LV_USE_MSGBOX is not set
# CONFIG_LV_USE_SPAN is not set
# CONFIG_LV_USE_SPINBOX is not set
# CONFIG_LV_USE_SPINNER is not set
# CONFIG_LV_USE_TABVIEW is not set
# CONFIG_LV_USE_TILEVIEW is not set
# CONFIG_LV_USE_WIN is not set
# CONFIG_LV_USE_CANVAS is not set
# CONFIG_LV_USE_CHECKBOX is not set
# CONFIG_LV_USE_DROPDOWN is not set
# CONFIG_LV_USE_LINE is not set
# CONFIG_LV_USE_ROLLER is not set
# CONFIG_LV_USE_SLIDER is not set
# CONFIG_LV_USE_SWITCH is not set
CONFIG_LV_USE_FS_POSIX=y
CONFIG_LV_USE_IMG=y
CONFIG_LV_USE_LABEL=y
CONFIG_LV_USE_BTN=y
CONFIG_MBEDTLS_DYNAMIC_FREE_CA_CERT=y
CONFIG_MBEDTLS_DYNAMIC_FREE_CONFIG_DATA=y
# CONFIG_MBEDTLS_TLS_SERVER is not set
# CONFIG_MBEDTLS_CERTIFICATE_BUNDLE is not set
# CONFIG_MDNS_STRICT_MODE is not set
CONFIG_PARTITION_TABLE_CUSTOM=y
CONFIG_PARTITION_TABLE_CUSTOM_FILENAME="partitions_alexa.csv"
CONFIG_PSRAM_MODE_OCT=y
CONFIG_RINGBUF_PLACE_FUNCTIONS_INTO_FLASH=y
# CONFIG_SECURE_BOOT_ALLOW_ROM_BASIC is not set
# CONFIG_SECURE_BOOT_ALLOW_JTAG is not set
CONFIG_SPI_FLASH_DANGEROUS_WRITE_ALLOWED=y
CONFIG_SPIRAM_FETCH_INSTRUCTIONS=y
CONFIG_SPIRAM_RODATA=y
# CONFIG_SR_MN_CN_MULTINET4_5_Q8_OP2 is not set
# CONFIG_SR_MN_EN_MULTINET5_Q8_OP2 is not set
CONFIG_SR_WN_WN9_ALEXA=y
CONFIG_TASK_WDT_CHECK_IDLE_TASK_CPU0=y
CONFIG_TASK_WDT_CHECK_IDLE_TASK_CPU1=y
CONFIG_USE_AFE_SR_MODEL=y
CONFIG_USE_WAKENET=y
CONFIG_WEBSOCKET_TRANSPORT_OVER_TCP=y
CONFIG_COMPILER_DISABLE_GCC13_WARNINGS=y
```
